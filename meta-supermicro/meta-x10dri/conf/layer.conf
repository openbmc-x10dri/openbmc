## meta-supermicro/meta-x10dri/conf/layer.conf
```bitbake
# We have a conf and classes directory, add to BBPATH
BBPATH .= ":${LAYERDIR}"

# We have recipes-* directories, add to BBFILES
BBFILES += "${LAYERDIR}/recipes-*/*/*.bb \
            ${LAYERDIR}/recipes-*/*/*.bbappend"

BBFILE_COLLECTIONS += "x10dri"
BBFILE_PATTERN_x10dri = ""

BBFILE_PRIORITY_x10dri = "5"
LAYERSERIES_COMPAT_x10dri = "kirkstone langdale"
```

## meta-supermicro/meta-x10dri/conf/machine/x10dri.conf
```bitbake
KMACHINE = "aspeed"
KERNEL_DEVICETREE = "aspeed-bmc-supermicro-x10dri.dtb"

require conf/machine/include/ast2400.inc
require conf/machine/include/obmc-bsp-common.inc
require conf/machine/include/supermicro.inc

PREFERRED_PROVIDER_virtual/bootloader = "u-boot-aspeed"
PREFERRED_PROVIDER_u-boot = "u-boot-aspeed"
PREFERRED_PROVIDER_u-boot-fw-utils = "u-boot-fw-utils-aspeed"
UBOOT_MACHINE = "ast_g4_phy_config"

PREFERRED_PROVIDER_virtual/phosphor-led-manager-config-native = "x10dri-led-manager-config-native"

FLASH_SIZE = "32768"

VIRTUAL-RUNTIME_skeleton_workbook = "${MACHINE}-config"
```
